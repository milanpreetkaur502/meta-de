## conf/layer.conf
```bitbake
# We have a conf and classes directory, add to BBPATH
BBPATH .= ":${LAYERDIR}"

# We have recipes-* directories, add to BBFILES
BBFILES += "${LAYERDIR}/recipes-*/*/*.bb \
            ${LAYERDIR}/recipes-*/*/*.bbappend"

BBFILE_COLLECTIONS += "meta-de"
BBFILE_PATTERN_meta-de = "^${LAYERDIR}/"
BBFILE_PRIORITY_meta-de = "24"

LAYERDEPENDS_meta-de = "core"
LAYERSERIES_COMPAT_meta-de = "dunfell"
```

## conf/machine/apalis-imx8-extra.conf
```bitbake
TEZI_EXTERNAL_KERNEL_DEVICETREE_BOOT_append = " apalis-imx8_ar0521_overlay.dtbo"
```
